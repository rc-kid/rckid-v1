#pragma once

#include "avr.h"

/** PCD8544 aka the nokia 5110 display. 
 
    RST connection is not absolutely necessary. When not used it should be held high. 
 */

template<uint8_t RST, uint8_t SCE, uint8_t DC>
class PCD8544 {
public:
    PCD8544() {
        output<RST>();
        output<SCE>();
        output<DC>();
        high<RST>();
        high<SCE>();
        high<DC>();
	}
	
	void reset() {
        low<RST>();
        delay(10);
        high<RST>();
	}
	
	void enable() {
        reset();
        begin();
		writeCommand(0x21); // extended commands, power on
		writeCommand(0xbf); // VOP (contrast)
		writeCommand(0x04); // temp coef 
		writeCommand(0x14); // bias mode 1:48
		writeCommand(0x20); // basic commands, power on
		normalMode();
        gotoXY(0,0);
		clear();
        end();
	}
	
	void disable() {
        begin();
		writeCommand(0b00100100);
        end();
	}
	
	void normalMode() {
        begin();
		writeCommand(0x0c); // normal mode
        end();
	}
	
	void inverseMode() {
        begin();
		writeCommand(0x0d); // inverse mode
        end();
	}
	
	void clear() {
        begin();
	    for (int i = 0; i < 84 * 48 / 8; ++i)
		    writeData(0);	
        end();
	}
	
	void gotoXY(uint8_t col, uint8_t row) {
        begin();
	    writeCommand(0x80 | col);
		writeCommand(0x40 | row);	
        end();
	}
	
    /** Displays a single character.
     */
	void write(char x) {
        begin();
        writeChar(x);
        end();
	}
	
    /** Writes a null-terminated string. 
     */
	void write(char const * x) {
        begin();
	    while (*x != 0) {
            writeChar(*x);
            ++x;
        }
        end();
	}

    /** Writes a null-terminated string to a given position. 
     */
    void write(uint8_t col, uint8_t row, char const * x) {
        begin();
	    writeCommand(0x80 | col);
		writeCommand(0x40 | row);	
        while (*x != 0) {
            writeChar(*x);
            ++x;
        }
        end();
    }

    /** Writes a null-terminated string to a given position, using scaled font (2x larger) to a given position. 
     
        The large text uses the same font, but doubles each pixel, i.e. a cell size will become 10x16.
     */
    void writeLarge(uint8_t col, uint8_t row, char const * x) {
        begin();
	    writeCommand(0x80 | col);
		writeCommand(0x40 | row);	
        char const * xx = x;
        while (*xx != 0) {
            uint8_t * d = Font_ + (*xx - 0x20) * 5;
            for (uint8_t i = 0; i < 5; ++i) {
                uint8_t v = expandNibble(d[i]);
                writeData(v);
                writeData(v);
            }
            writeData(0);
            writeData(0);
            ++xx;
        }
	    writeCommand(0x80 | col);
		writeCommand(0x40 | row + 1);
        while (*x != 0) {
            uint8_t * d = Font_ + (*x - 0x20) * 5;
            for (uint8_t i = 0; i < 5; ++i) {
                uint8_t v = expandNibble(d[i] >> 4);
                writeData(v);
                writeData(v);
            }
            writeData(0);
            writeData(0);
            ++x;
        }
        end();
    }
	
    /** Writes an unsigned 16bit integer. 
     
        If the fill character is '\0' (default), the number will be left-justified, if ' ' it will be right justified, '0' will print all leading zeros as well. 
     */
	void write(uint16_t x, char fill = '\0') {
        begin();
        for (uint16_t i = 10000; i > 0; i = i / 10) {
            if (x > i || i == 1) {
                writeChar((x / i) + '0');
                fill = '0';
                x = x % i;
            } else if (fill != '\0') {
                writeChar(fill);
            }
        }
        end();
	}

    /** Displays a horizontal bar. 
     */
    void horizontalBar(uint8_t col, uint8_t row, uint8_t size, uint8_t value) {

    }
	
private:

    void begin() {
        spi::begin();
        low<SCE>();
    }

    void end() {
        high<SCE>();
        spi::end();
    }

    void writeCommand(uint8_t cmd) {
        low<DC>();
        spi::transfer(cmd);
        high<DC>();
	}
	
	void writeData(uint8_t data) {
        spi::transfer(data);
	}

    void writeData(uint8_t * data, uint16_t size) {
        spi::transfer(data, size);
    }

    void writeChar(char c) {
        writeData(Font_ + (c - 0x20) * 5, 5);
        //writeData(0);
    }

    static constexpr inline uint8_t Font_[] = {
        0x00, 0x00, 0x00, 0x00, 0x00, // 20 space
	    0x00, 0x00, 0x5f, 0x00, 0x00, // 21!
	    0x00, 0x07, 0x00, 0x07, 0x00, // 22 "
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		0x00, 0x06, 0x09, 0x09, 0x06, // 7f ?
    };

} ;


